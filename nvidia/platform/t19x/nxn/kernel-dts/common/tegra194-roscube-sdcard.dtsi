/*
 * Copyright (c) 2020, ADLINK Technology Inc Advanved Robotic Platform Group.  All rights reserved.
 *
 * This program is free software; you can redistribute it and/or modify
 * it under the terms of the GNU General Public License as published by
 * the Free Software Foundation; version 2 of the License.
 *
 * This program is distributed in the hope that it will be useful, but WITHOUT
 * ANY WARRANTY; without even the implied warranty of MERCHANTABILITY or
 * FITNESS FOR A PARTICULAR PURPOSE.  See the GNU General Public License for
 * more details.
 */

 / {
	sdcard: sdhci@3440000 {
		mmc-ocr-mask = <0x0>;
		cd-inverted;
		cd-gpios = <&tegra_main_gpio TEGRA194_MAIN_GPIO(Q, 2) 0>;
		nvidia,cd-wakeup-capable;
		status = "okay";
	};
 };